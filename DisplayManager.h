#ifndef DISPLAY_MANAGER_H
#define DISPLAY_MANAGER_H

#include <Arduino.h>
#include <Wire.h>
#include <Adafruit_GFX.h>
#include <Adafruit_SSD1306.h>

#define SCREEN_WIDTH 128
#define SCREEN_HEIGHT 64
#define SDA_PIN 6
#define SCL_PIN 7
#define TOUCH_PIN 4

// OLED display driver
Adafruit_SSD1306 display(SCREEN_WIDTH, SCREEN_HEIGHT, &Wire, -1);
// Spring physics Eye structure
struct Eye {
  float x, y;  // Current position
  float w, h;  // Current size
  float targetX, targetY, targetW, targetH;

  // Pupil Physics (Secondary drag motion)
  float pupilX, pupilY;
  float targetPupilX, targetPupilY;

  float velX, velY, velW, velH;
  float pVelX, pVelY;
  float k = 0.12;   // Spring constant
  float d = 0.60;   // Damping constant
  float pk = 0.08;  // Pupil spring constant
  float pd = 0.50;  // Pupil damping constant

  bool blinking;
  unsigned long lastBlink;
  unsigned long nextBlinkTime;

  void init(float _x, float _y, float _w, float _h) {
    x = targetX = _x;
    y = targetY = _y;
    w = targetW = _w;
    h = targetH = _h;
    pupilX = targetPupilX = 0;
    pupilY = targetPupilY = 0;
    nextBlinkTime = millis() + random(3000, 10000);
  }

  void update() {
    float ax = (targetX - x) * k;
    float ay = (targetY - y) * k;
    float aw = (targetW - w) * k;
    float ah = (targetH - h) * k;

    velX = (velX + ax) * d;
    velY = (velY + ay) * d;
    velW = (velW + aw) * d;
    velH = (velH + ah) * d;

    x += velX;
    y += velY;
    w += velW;
    h += velH;

    float pax = (targetPupilX - pupilX) * pk;
    float pay = (targetPupilY - pupilY) * pk;
    pVelX = (pVelX + pax) * pd;
    pVelY = (pVelY + pay) * pd;
    pupilX += pVelX;
    pupilY += pVelY;
  }
};


// --- EMOTION PARTICLES (16x16) ---
const unsigned char bmp_heart[] PROGMEM = { 0x00, 0x00, 0x0c, 0x60, 0x1e, 0xf0, 0x3f, 0xf8, 0x7f, 0xfc, 0x7f, 0xfc, 0x7f, 0xfc, 0x3f, 0xf8, 0x1f, 0xf0, 0x0f, 0xe0, 0x07, 0xc0, 0x03, 0x80, 0x01, 0x00, 0x00, 0x00, 0x00, 0x00, 0x00, 0x00 };
const unsigned char bmp_zzz[] PROGMEM = { 0x00, 0x00, 0x00, 0x00, 0x00, 0x00, 0x00, 0x3c, 0x00, 0x0c, 0x00, 0x18, 0x00, 0x30, 0x00, 0x7e, 0x00, 0x00, 0x3c, 0x00, 0x0c, 0x00, 0x18, 0x00, 0x30, 0x00, 0x7c, 0x00, 0x00, 0x00, 0x00, 0x00 };
const unsigned char bmp_anger[] PROGMEM = { 0x00, 0x00, 0x11, 0x10, 0x2a, 0x90, 0x44, 0x40, 0x80, 0x20, 0x80, 0x20, 0x44, 0x40, 0x2a, 0x90, 0x11, 0x10, 0x00, 0x00, 0x00, 0x00, 0x00, 0x00, 0x00, 0x00, 0x00, 0x00, 0x00, 0x00, 0x00, 0x00 };

// --- COMPANION CUSTOM BITMAPS (16x16) ---
const unsigned char bmp_book[] PROGMEM = {
  0x7f, 0xfe, 0x40, 0x02, 0x5f, 0xfa, 0x5f, 0xfa, 0x5f, 0xfa, 0x5f, 0xfa, 0x5f, 0xfa, 0x5f, 0xfa,
  0x5f, 0xfa, 0x5f, 0xfa, 0x40, 0x02, 0x7f, 0xfe, 0x3f, 0xfc, 0x0f, 0xf0, 0x03, 0xc0, 0x01, 0x80
};

const unsigned char bmp_coffee[] PROGMEM = {
  0x00, 0x00, 0x0a, 0x80, 0x05, 0x00, 0x0a, 0x80, 0x3f, 0xf0, 0x20, 0x18, 0x20, 0x0c, 0x20, 0x0c,
  0x20, 0x18, 0x3f, 0xf0, 0x1f, 0xe0, 0x0f, 0xc0, 0x07, 0x80, 0x00, 0x00, 0x7f, 0xfe, 0x00, 0x00
};

const unsigned char bmp_star[] PROGMEM = {
  0x10, 0x38, 0x7c, 0xfe, 0x7c, 0x38, 0x28, 0x44
};

// --- CHROME DINO RETRO SPRITES (16x16) ---
const unsigned char bmp_dino_run1[] PROGMEM = {
  0x00, 0x7c, 0x00, 0xfe, 0x00, 0xee, 0x00, 0xfe, 0x07, 0xf0, 0x0f, 0xf8, 0x1f, 0xf8, 0x1f, 0xf0,
  0x1f, 0xe0, 0x0f, 0xc0, 0x07, 0x80, 0x03, 0x80, 0x02, 0x40, 0x02, 0x40, 0x03, 0x00, 0x02, 0x00
};

const unsigned char bmp_dino_run2[] PROGMEM = {
  0x00, 0x7c, 0x00, 0xfe, 0x00, 0xee, 0x00, 0xfe, 0x07, 0xf0, 0x0f, 0xf8, 0x1f, 0xf8, 0x1f, 0xf0,
  0x1f, 0xe0, 0x0f, 0xc0, 0x07, 0x80, 0x03, 0x80, 0x01, 0x20, 0x01, 0x20, 0x00, 0xc0, 0x00, 0x40
};

const unsigned char bmp_dino_jump[] PROGMEM = {
  0x00, 0x7c, 0x00, 0xfe, 0x00, 0xee, 0x00, 0xfe, 0x07, 0xf0, 0x0f, 0xf8, 0x1f, 0xf8, 0x1f, 0xf0,
  0x1f, 0xe0, 0x0f, 0xc0, 0x07, 0x80, 0x03, 0x80, 0x02, 0x40, 0x02, 0x40, 0x03, 0xc0, 0x00, 0x00
};

// --- OBSTACLE SPRITES ---
const unsigned char bmp_cactus1[] PROGMEM = {
  0x18, 0x18, 0x58, 0xd8, 0xd8, 0xff, 0xd8, 0x18, 0x18, 0x18, 0x18, 0x18
};

const unsigned char bmp_cactus2[] PROGMEM = {
  0x0c, 0x30, 0x0c, 0x30, 0x2c, 0xb0, 0x6c, 0xb0, 0x6c, 0xf0, 0x7f, 0xf0, 0x6c, 0x30, 0x0c, 0x30,
  0x0c, 0x30, 0x0c, 0x30, 0x0c, 0x30, 0x0c, 0x30
};

const unsigned char bmp_rock[] PROGMEM = {
  0x3c, 0x7e, 0xff, 0xff, 0xdb, 0xff
};

// --- VIRTUAL PET BITMAPS (16x16) ---
const unsigned char bmp_baby_idle[] PROGMEM = { 0x00, 0x00, 0x00, 0x00, 0x00, 0x00, 0x00, 0x00, 0x03, 0xc0, 0x07, 0xe0, 0x0e, 0x70, 0x0f, 0xf0, 0x0f, 0xf0, 0x07, 0xe0, 0x03, 0xc0, 0x00, 0x00, 0x00, 0x00, 0x00, 0x00, 0x00, 0x00, 0x00, 0x00 };
const unsigned char bmp_baby_move[] PROGMEM = { 0x00, 0x00, 0x00, 0x00, 0x00, 0x00, 0x00, 0x00, 0x01, 0x80, 0x07, 0xe0, 0x0f, 0xf0, 0x0e, 0x70, 0x0f, 0xf0, 0x07, 0xe0, 0x01, 0x80, 0x00, 0x00, 0x00, 0x00, 0x00, 0x00, 0x00, 0x00, 0x00, 0x00 };

const unsigned char bmp_child_idle[] PROGMEM = { 0x03, 0x80, 0x07, 0xc0, 0x07, 0x40, 0x07, 0xc0, 0x03, 0xc0, 0x01, 0xe0, 0x03, 0xf0, 0x07, 0xf8, 0x07, 0xd8, 0x07, 0xf8, 0x03, 0xf0, 0x02, 0x20, 0x02, 0x20, 0x03, 0x30, 0x00, 0x00, 0x00, 0x00 };
const unsigned char bmp_child_walk[] PROGMEM = { 0x03, 0x80, 0x07, 0xc0, 0x07, 0x40, 0x07, 0xc0, 0x03, 0xc0, 0x01, 0xe0, 0x03, 0xf0, 0x07, 0xf8, 0x07, 0xd8, 0x07, 0xf8, 0x03, 0xf0, 0x02, 0x00, 0x00, 0x20, 0x03, 0x30, 0x00, 0x00, 0x00, 0x00 };

const unsigned char bmp_teen_idle[] PROGMEM = { 0x0f, 0xc0, 0x1f, 0xe0, 0x1d, 0x60, 0x1f, 0xe0, 0x0f, 0xe0, 0x07, 0xc0, 0x0f, 0xf0, 0x1f, 0xf8, 0x3f, 0xfc, 0x3d, 0xbc, 0x3f, 0xfc, 0x1f, 0xf8, 0x0f, 0xf0, 0x0a, 0x50, 0x0a, 0x50, 0x00, 0x00 };
const unsigned char bmp_teen_walk[] PROGMEM = { 0x0f, 0xc0, 0x1f, 0xe0, 0x1d, 0x60, 0x1f, 0xe0, 0x0f, 0xe0, 0x07, 0xc0, 0x0f, 0xf0, 0x1f, 0xf8, 0x3f, 0xfc, 0x3d, 0xbc, 0x3f, 0xfc, 0x1f, 0xf8, 0x0f, 0xf0, 0x08, 0x10, 0x02, 0x40, 0x00, 0x00 };

const unsigned char bmp_adult_idle[] PROGMEM = { 0x0f, 0xc0, 0x1f, 0xe0, 0x3d, 0xb0, 0x3f, 0xf0, 0x0f, 0xe0, 0x27, 0xc4, 0x6f, 0xf6, 0xff, 0xff, 0xff, 0xff, 0x7f, 0xfe, 0x3f, 0xfc, 0x1f, 0xf8, 0x0f, 0xf0, 0x09, 0x90, 0x09, 0x90, 0x00, 0x00 };
const unsigned char bmp_adult_walk[] PROGMEM = { 0x0f, 0xc0, 0x1f, 0xe0, 0x3d, 0xb0, 0x3f, 0xf0, 0x0f, 0xe0, 0x27, 0xc4, 0x6f, 0xf6, 0xff, 0xff, 0xff, 0xff, 0x7f, 0xfe, 0x3f, 0xfc, 0x1f, 0xf8, 0x0f, 0xf0, 0x08, 0x10, 0x01, 0x80, 0x00, 0x00 };

const unsigned char bmp_pet_sleep[] PROGMEM = { 0x00, 0x00, 0x00, 0x00, 0x03, 0xc0, 0x07, 0xe0, 0x0e, 0x70, 0x0c, 0x30, 0x1f, 0xf8, 0x3f, 0xfc, 0x3f, 0xfc, 0x3d, 0xbc, 0x1f, 0xf8, 0x0f, 0xf0, 0x00, 0x00, 0x00, 0x00, 0x00, 0x00, 0x00, 0x00 };
const unsigned char bmp_pet_wave[] PROGMEM = { 0x0f, 0xc0, 0x1f, 0xe0, 0x1d, 0x60, 0x3f, 0xe0, 0x7f, 0xe0, 0x0f, 0xe0, 0x0f, 0xf0, 0x1f, 0xf8, 0x3f, 0xfc, 0x3f, 0xfc, 0x1f, 0xf8, 0x0a, 0x50, 0x0a, 0x50, 0x00, 0x00, 0x00, 0x00, 0x00, 0x00 };


// --- EYES DRAWING AND PHYSICALS MASKING ---

void drawEyelidMask(float x, float y, float w, float h, int mood, bool isLeft) {
  int ix = (int)x;
  int iy = (int)y;
  int iw = (int)w;
  int ih = (int)h;

  if (mood == MOOD_ANGRY) {
    if (isLeft)
      for (int i = 0; i < 16; i++) display.drawLine(ix, iy + i, ix + iw, iy - 6 + i, SSD1306_BLACK);
    else
      for (int i = 0; i < 16; i++) display.drawLine(ix, iy - 6 + i, ix + iw, iy + i, SSD1306_BLACK);
  }
  else if (mood == MOOD_SAD) {
    if (isLeft)
      for (int i = 0; i < 16; i++) display.drawLine(ix, iy - 6 + i, ix + iw, iy + i, SSD1306_BLACK);
    else
      for (int i = 0; i < 16; i++) display.drawLine(ix, iy + i, ix + iw, iy - 6 + i, SSD1306_BLACK);
  }
  else if (mood == MOOD_HAPPY || mood == MOOD_LOVE || mood == MOOD_EXCITED) {
    display.fillRect(ix, iy + ih - 10, iw, 12, SSD1306_BLACK);
    display.fillCircle(ix + iw / 2, iy + ih + 6, iw / 1.3, SSD1306_BLACK);
  }
  else if (mood == MOOD_SLEEPY) {
    display.fillRect(ix, iy, iw, ih / 2 + 2, SSD1306_BLACK);
  }
  else if (mood == MOOD_SUSPICIOUS) {
    if (isLeft) display.fillRect(ix, iy, iw, ih / 2 - 2, SSD1306_BLACK);
    else display.fillRect(ix, iy + ih - 8, iw, 8, SSD1306_BLACK);
  }
}

void drawSunglasses(int lx, int ly, int lw, int lh, int rx, int ry, int rw, int rh) {
  display.fillRect(lx - 2, ly + 2, lw + 4, lh - 6, SSD1306_BLACK);
  display.drawRoundRect(lx - 2, ly + 2, lw + 4, lh - 6, 3, SSD1306_WHITE);
  display.fillRect(rx - 2, ry + 2, rw + 4, rh - 6, SSD1306_BLACK);
  display.drawRoundRect(rx - 2, ry + 2, rw + 4, rh - 6, 3, SSD1306_WHITE);
  display.drawLine(lx + lw - 2, ly + lh/2 - 2, rx + 2, ry + rh/2 - 2, SSD1306_WHITE);
  display.drawLine(lx + lw - 2, ly + lh/2 - 3, rx + 2, ry + rh/2 - 3, SSD1306_WHITE);
  display.drawLine(0, ly + lh/2 - 2, lx - 2, ly + lh/2 - 2, SSD1306_WHITE);
  display.drawLine(rx + rw + 2, ry + rh/2 - 2, 127, ry + rh/2 - 2, SSD1306_WHITE);
}

void drawUltraProEye(Eye& e, bool isLeft, int mood) {
  int ix = (int)e.x;
  int iy = (int)e.y;
  int iw = (int)e.w;
  int ih = (int)e.h;

  int r = 6;
  if (iw < 20) r = 3;

  if (currentEyeStyle == STYLE_CLASSIC) {
    display.fillRoundRect(ix, iy, iw, ih, r, SSD1306_WHITE);
  } else if (currentEyeStyle == STYLE_BOLD) {
    display.fillRoundRect(ix - 1, iy - 1, iw + 2, ih + 2, r + 1, SSD1306_WHITE);
  } else if (currentEyeStyle == STYLE_ROUND) {
    display.fillCircle(ix + iw / 2, iy + ih / 2, min(iw, ih) / 2 + 1, SSD1306_WHITE);
  } else if (currentEyeStyle == STYLE_SQUINTY) {
    display.fillRoundRect(ix, iy + ih / 4, iw, ih / 2, r / 2, SSD1306_WHITE);
  }

  int cx = ix + iw / 2;
  int cy = iy + ih / 2;
  int pw = iw / 2.2;
  int ph = ih / 2.2;

  int px = cx + (int)e.pupilX - (pw / 2);
  int py = cy + (int)e.pupilY - (ph / 2);

  int clampYMin = iy;
  int clampYMax = iy + ih - ph;
  if (currentEyeStyle == STYLE_SQUINTY) {
    ph = ih / 4;
    py = cy + (int)e.pupilY / 2 - (ph / 2);
    clampYMin = iy + ih / 4;
    clampYMax = iy + 3 * ih / 4 - ph;
  }

  if (px < ix) px = ix;
  if (px + pw > ix + iw) px = ix + iw - pw;
  if (py < clampYMin) py = clampYMin;
  if (py + ph > clampYMax) py = clampYMax;

  display.fillRoundRect(px, py, pw, ph, r / 2, SSD1306_BLACK);

  if (iw > 15 && ih > 15 && currentEyeStyle != STYLE_SQUINTY) {
    display.fillCircle(px + pw - 3, py + 3, 1, SSD1306_WHITE);
  }

  drawEyelidMask(e.x, e.y, e.w, e.h, mood, isLeft);
}

void drawMouth(int cx, int cy, int mood) {
  switch (mood) {
    case MOOD_HAPPY:
    case MOOD_LOVE:
    case MOOD_EXCITED:
      display.fillCircle(cx, cy, 6, SSD1306_WHITE);
      display.fillRect(cx - 7, cy - 7, 14, 8, SSD1306_BLACK);
      break;
    case MOOD_SAD:
    case MOOD_ANGRY:
      display.fillCircle(cx, cy, 6, SSD1306_WHITE);
      display.fillRect(cx - 7, cy - 1, 14, 8, SSD1306_BLACK);
      break;
    case MOOD_SURPRISED:
      display.drawCircle(cx, cy, 4, SSD1306_WHITE);
      display.drawCircle(cx, cy, 5, SSD1306_WHITE);
      break;
    case MOOD_SLEEPY:
      display.drawCircle(cx, cy, 2, SSD1306_WHITE);
      break;
    case MOOD_SUSPICIOUS:
      for (int t = 0; t < 2; t++) {
        display.drawLine(cx - 10, cy + 2 + t, cx + 10, cy - 2 + t, SSD1306_WHITE);
      }
      break;
    case MOOD_COOL:
      for (int t = 0; t < 2; t++) {
        display.drawLine(cx - 6, cy + t, cx + 6, cy - 2 + t, SSD1306_WHITE);
      }
      break;
    case MOOD_NORMAL:
    default:
      for (int t = 0; t < 2; t++) {
        display.drawLine(cx - 8, cy + t, cx + 8, cy + t, SSD1306_WHITE);
      }
      break;
  }
}

void drawBLEIcon(int x, int y) {
  if (!bleConnected) return;
  display.drawLine(x + 2, y,     x + 2, y + 8, SSD1306_WHITE);
  display.drawLine(x + 2, y,     x + 4, y + 2, SSD1306_WHITE);
  display.drawLine(x + 4, y + 2, x,     y + 4, SSD1306_WHITE);
  display.drawLine(x,     y + 4, x + 4, y + 6, SSD1306_WHITE);
  display.drawLine(x + 4, y + 6, x + 2, y + 8, SSD1306_WHITE);
}

#endif
